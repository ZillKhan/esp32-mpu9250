## main/Kconfig
```kconfig
menu "MPU9250 Configuration"

config CALIBRATION_MODE
    bool "When running, go into calibration mode."
    default n
    help
      Each MPU9250 needs to be calibrated before it will work properly.  When enabled, this will go through
      a set of calibration instructions.

endmenu
```
